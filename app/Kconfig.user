## app/modules/Kconfig
```kconfig
menu "NodeMCU modules"

menu "Data Structures and Mathematics" # {{{

config NODEMCU_CMODULE_BIT
  bool "bit Module"
  default "n"
  help
    Provides native functions for bitwise math operations

config NODEMCU_CMODULE_BLOOM
  bool "Bloom Module"
  default "n"
  help
    Bloom filters are efficient stochastic sets with one-sided error.

config NODEMCU_CMODUlE_COLOR_UTILS
  bool "color utils Module"
  default "n"
  help
    Functions for performing math in and between different color spaces.

config NODEMCU_CMODULE_CRYPTO
  bool "crypto Module"
  default "n"
  depends on NODEMCU_CMODULE_ENCODER
  help
   Functions for low-level cryptography: hashes, MACs, & symmetric ciphering

config NODEMCU_CMODULE_ENCODER
  bool "encoder Module"
  default "n"
  help
    Base16 and Base64 en-/de-coding

config NODEMCU_CMODULE_PIPE
  bool "pipe Module"
  default "n"
  help
    An efficient queue of bytes

config NODEMCU_CMODULE_SJSON
  bool "SJSON module"
  default "n"
  help
    Bindings to the jsonsl library for JSON en-/de-coding

config NODEMCU_CMODULE_STRUCT
  bool "struct Module"
  default "n"
  help
    Provides a simple packed structure (de)serializer

endmenu # }}}
menu "Development and Debugging" # {{{

config NODEMCU_CMODULE_GDBSTUB
  bool "gdbstub Module"
  default "n"
  help
    The gdb stub allows interactive debugging of the NodeMCU firmware from
    a remote computer using the UART link.

config NODEMCU_CMODULE_PERF
  bool "perf Module"
  default "n"
  help
    A sampling-based statistical runtime profiler

endmenu # }}}
menu "ESP8266 Intrinsic Feature Support" # {{{

config NODEMCU_CMODULE_ADC
  bool "adc Module"
  default "n"
  help
    Provides access to the on-board one-channel ADC

config NODEMCU_CMODULE_CRON
  bool "cron Module"
  default "n"
  help
    Exposes on-device timers with crontab-style specification for callbacks

config NODEMCU_CMODULE_FILE
  bool "file Module"
  default "y"
  help
    Exposes on-device FLASH as a filesystem using SPIFFS

config NODEMCU_CMODULE_GPIO
  bool "gpio Module"
  default "y"
  help
    Provides access to hardware General Purpose I/O pins

config NODEMCU_CMODULE_GPIO_PULSE
  bool "gpio_pulse Module"
  default "y"
  help
    Generates accurately-timed square waveforms on GPIO pins

config NODEMCU_CMODULE_NODE
  bool "node Module"
  default "y"
  help
    Exposes information about NodeMCU and the hardware; is also the interface
    to LFS and for rebooting the module.

config NODEMCU_CMODULE_PCM
  bool "pcm Module"
  default "n"
  help
    Feeds PCM data to the onboard sigma-delta generator 

config NODEMCU_CMODULE_PWM
  bool "pwm Module"
  default "n"

config NODEMCU_CMODULE_PWM2
  bool "pwm2 Module"
  default "n"

config NODEMCU_CMODULE_RTCFIFO
  bool "rtcfifo Module"
  default "n"
  help
    Provides access to the onboard RTC memory through a FIFO interface.

config NODEMCU_CMODULE_RTCMEM
  bool "rtcmem Module"
  default "n"
  help
    Provides raw access to the onboard RTC memory

config NODEMCU_CMODULE_RTCTIME
  bool "rtctime Module"
  default "n"
  help
    Advanced time-keeping support using the onboard RTC

config NODEMCU_CMODULE_SIGMA_DELTA
  bool "sigma_delta Module"
  default "n"

config NODEMCU_CMODULE_SOFTUART
  bool "softuart Module"
  default "n"

config NODEMCU_CMODULE_TMR
  bool "tmr Module"
  default "y"

config NODEMCU_CMODULE_UART
  bool "uart Module"
  default "y"

config NODEMCU_CMODULE_WIFI
  bool "wifi Module"
  default "y"
  help
    Provides access to the on-board WiFi chipset

config NODEMCU_CMODULE_WIFI__EVENT
  bool "Enable WiFi Event callbacks"
  depends on NODEMCU_CMODULE_WIFI
  default "y"
  help
    Enables wifi.sta.config() event callbacks

config NODEMCU_CMODULE_WIFI__EVENT_DISCONN_REASON
  bool "Enable wifi.eventmon.reason table"
  depends on NODEMCU_CMODULE_WIFI
  default "y"

config NODEMCU_CMODULE_WIFI__SMART
  bool "Use the Espressif SDK WiFi connection management logic"
  depends on NODEMCU_CMODULE_WIFI
  default "n"
  help
    The WiFi module optionally offers an enhanced level of WiFi connection
    management, using internal timer callbacks.  Whilst many Lua developers
    prefer to implement equivalent features in Lua, others will prefer the
    Wifi module to do this for them.  Selecting "y" here will enable the
    wifi.startsmart() and wifi.stopsmart() functions.  See the documentation
    for further details, as the scope of these changes is not obvious.

config NODEMCU_CMODULE_WIFI_MONITOR
  bool "wifi.monitor Module"
  default "n"

config NODEMCU_CMODULE_WPS
  bool "wps Module"
  default "n"

endmenu

menu "Networking"

config NODEMCU_CMODULE_COAP
  bool "coap Module"
  default "n"
  help
    COnstrained Application Protocol implementation

config NODEMCU_CMODULE_ENDUSER_SETUP
  bool "enduser_setup Module"
  default "n"
  # depends DNS_SERVER
  help
    Configure ESP8266 over WiFi rather than a UART link

config NODEMCU_CMODULE_ENDUSER_SETUP__AP_SSID
  string "enduser_setup default AP name"
  depends on NODEMCU_CMODULE_ENDUSER_SETUP
  default "SetupGadget"
  help
    Set the default SSID when this module is running in AP mode as part of
    enduser setup.

config NODEMCU_CMODULE_HTTP
  bool "http Module"
  default "n"
  help
    HyperText Transport Protocol client

config NODEMCU_CMODULE_MDNS
  bool "mdns Module"
  default "n"
  help
    Multicast DNS responder (i.e., server) module

config NODEMCU_CMODULE_MQTT
  bool "mqtt Module"
  default "n"
  help
    MQ Telemetry Transport protocol version 3.1.1.

config NODEMCU_CMODULE_NET
  bool "net Module"
  default "y"

config NODEMCU_CMODULE_NET__PING
  bool "net.ping support"
  depends on NODEMCU_CMODULE_NET
  default "y"

config NODEMCU_CMODULE_SNTP
  bool "sntp Module"
  default "n"
  help
    Simple Network Time Protocol implementation

config NODEMCU_CMODULE_TLS
  bool "tls Module"
  default "n"
  help
    Transport Layer Security client implementation

config NODEMCU_CMODULE_WEBSOCKET
  bool "websocket Module"
  default "n"

endmenu # }}}
menu "Wire Protocol Drivers" # {{{

config NODEMCU_CMODULE_DCC
  bool "dcc Module"
  default "n"
  help
     National Model Railroad Association (NMRA) Digital Command Control (DCC) decoder

config NODEMCU_CMODULE_I2C
  bool "i2c Module"
  default "n"
  help
    Inter-Integrated Circuit (I2C, IIC) AKA Two-Wire Interface (TWI) master

config NODEMCU_CMODULE_I2C__OLD
  bool "Use the old I2C software driver"
  default "n"
  depends on NODEMCU_CMODULE_I2C
  help
    For compatibility reasons you can switch to old version of I2C software driver.
    It does not support changing speed, have only one bus id = 0, does not support GPIO16
    and works only in Standard(slow) mode with clock speed around 50kHz.

config NODEMCU_CMODULE_I2C__GPIO16
  bool "Enable the use of GPIO16 with the I2C module"
  depends on NODEMCU_CMODULE_I2C && !NODEMCU_CMODULE_I2C__OLD
  default "n"
  help
    The new I2C software driver partially supports use of GPIO16 (D0) pin for
    SCL line.  GPIO16 does not support open-drain mode and works in push-pull
    mode, so clock stretching will not be possible, because circuit in slave
    device that supposed to drive SCL low during stretching will not be able
    to hold SCL low.  Also I2C speed will be limited to no more than 400000
    Hz (FAST mode).

config NODEMCU_CMODULE_OW
  bool "ow Module"
  default "n"
  help
    Dallas Semiconductor / Maxim Integrated Products 1-Wire master

config NODEMCU_CMODULE_RFSWITCH
  bool "rfswitch Module"
  default "n"
  help
    Generate waveforms for transmission to low-cost 433/315MHz control devices

config NODEMCU_CMODULE_SPI
  bool "spi Module"
  default "n"
  help
    Serial Peripheral Interface master

endmenu # }}}
menu "External Device Drivers" # {{{

config NODEMCU_CMODULE_ADS1115
  bool "ads1115 Module"
  default "n"

config NODEMCU_CMODULE_ADXL345
  bool "adxl345 Module"
  default "n"

config NODEMCU_CMODULE_AM2320
  bool "am2320 Module"
  default "n"

config NODEMCU_CMODULE_APA102
  bool "apa102 Module"
  default "n"

config NODEMCU_CMODULE_BMP085
  bool "bmp085 Module"
  default "n"

config NODEMCU_CMODULE_BME280
  bool "bme280 Module"
  default "n"

config NODEMCU_CMODULE_BME680
  bool "bme680 Module"
  default "n"

config NODEMCU_CMODULE_DHT
  bool "dht Module"
  default "n"

config NODEMCU_CMODULE_HDC1080
  bool "hdc1080 Module"
  default "n"

config NODEMCU_CMODULE_HMC5883L
  bool "hmc5883l Module"
  default "n"

config NODEMCU_CMODULE_HX711
  bool "hx711 Module"
  default "n"

config NODEMCU_CMODULE_L3G4200D
  bool "l3g4200d Module"
  default "n"

config NODEMCU_CMODULE_MCP4725
  bool "mcp4725 Module"
  default "n"

config NODEMCU_CMODULE_ROTARY
  bool "rotary Module"
  default "n"

config NODEMCU_CMODULE_SI7021
  bool "si7021 Module"
  default "n"

config NODEMCU_CMODULE_SWITEC
  bool "switec Module"
  default "n"

config NODEMCU_CMODULE_TCS34725
  bool "tcs34725 Module"
  default "n"

config NODEMCU_CMODULE_TM1829
  bool "tm1829 Module"
  default "n"

config NODEMCU_CMODULE_TSL2561
  bool "tsl2561 Module"
  default "n"

config NODEMCU_CMODULE_U8G2
  bool "u8g2 Module"
  default "n"

config NODEMCU_CMODULE_UCG
  bool "ucg Module"
  default "n"

config NODEMCU_CMODULE_WS2801
  bool "ws2801 Module"
  default "n"

config NODEMCU_CMODULE_WS2812
  bool "ws2812 Module"
  default "n"

config NODEMCU_CMODULE_XPT2046
  bool "xpt2046 Module"
  default "n"

endmenu # }}}

endmenu
```

## components/base_nodemcu/Kconfig
```kconfig
menu "NodeMCU miscellaneous"

choice LUA_OPTIMIZE_DEBUG_LEVEL
  prompt "Discard debug info in compiled Lua"
  default LUA_OPTIMIZE_DEBUG_NONE
  help
      Discard debug information in compiled Lua code to save memory.

config LUA_OPTIMIZE_DEBUG_NONE
  bool "No (keep full debug info)"
config LUA_OPTIMIZE_DEBUG_LOCAL_UPVAL
  bool "Some (discard local & upvalue debug info)"
config LUA_OPTIMIZE_DEBUG_LOCAL_UPVAL_LINENO
  bool "All (discard local, upvalue & line number info)"
endchoice

config LUA_OPTIMIZE_DEBUG
  int
  default 1 if LUA_OPTIMIZE_DEBUG_NONE
  default 2 if LUA_OPTIMIZE_DEBUG_LOCAL_UPVAL
  default 3 if LUA_OPTIMIZE_DEBUG_LOCAL_UPVAL_LINENO

endmenu
```

## components/driver_can/Kconfig
```kconfig
menuconfig ESPCAN
    bool "ESPCan"
    default n
    help
        Select this option to enable esp can driver and show the submenu with esp can features.

config ESP_CAN_NODE_ITSELF
    int "ESP CAN Node itself"
    default 612
    range 0 1000
    depends on ESPCAN
    help
        ESP CAN NODE IDENTIFIER ITSELF.

config ESP_CAN_RXD_PIN_NUM
    int "Pin Number of CAN RXD"
    range 4 5
    default 4
    depends on ESPCAN
    help
        Number of CAN_RXD_PIN_NUM.
		Can be any unpulled GPIO. Check PIN List.
        Tested with GPIO4 so this is default.

config ESP_CAN_TXD_PIN_NUM
    int "Pin Number of CAN TXD"
    range 4 5
    default 5
    depends on ESPCAN
    help
        Number of CAN_TXD_PIN_NUM.
		Can be any unpulled GPIO. Check PIN List
        Tested with GPIO5 so this is default.

choice ESP_CAN_SPEED
    prompt "Select the ESP_CAN_SPEED used for the ESP CAN Driver"
	default CONFIG_CAN_SPEED_125KBPS
	depends on ESPCAN
	help
		CAN_SPEED_100KBPS 		CAN Node runs at 100kBits.
		CAN_SPEED_125KBPS 		CAN Node runs at 125kBits.
		CAN_SPEED_250KBPS 		CAN Node runs at 250kBits.
		CAN_SPEED_500KBPS 		CAN Node runs at 500kBits.
		CAN_SPEED_800KBPS 		CAN Node runs at 800kBits.
		CAN_SPEED_1000KBPS      CAN Node runs at 1000kBits.
		CAN_SPEED_USER_KBPS     CAN Node runs with custom speed

		You can select here a standard Baudrate.
		You can also set a Baudrate by user later as input here ( in work asap )
	
config CAN_SPEED_100KBPS
    bool "CAN SPEED 100KBPS"
    help
        Select this: CAN Node runs at 100kBits.

config CAN_SPEED_125KBPS
    bool "CAN SPEED 125KBPS"
    help
        Select this: CAN Node runs at 125kBits.

config CAN_SPEED_250KBPS
    bool "CAN SPEED 250KBPS"
    help
        Select this: CAN Node runs at 250kBits.

config CAN_SPEED_500KBPS
    bool "CAN SPEED 500KBPS"
    help
        Select this: CAN Node runs at 500kBits.

config CAN_SPEED_800KBPS
    bool "CAN SPEED 800KBPS"
    help
        Select this: CAN Node runs at 800kBits.
		
config CAN_SPEED_1000KBPS
    bool "CAN SPEED 1000KBPS"
    help
        Select this: CAN Node runs at 1000kBits.

config CAN_SPEED_USER_KBPS
    bool "CAN SPEED USER KBPS"
    help
        Select this: CAN Node runs at USER kBits.

config CAN_SPEED_USER_KBPS_VAL
    int "USER CAN Speed in kBit/s"
    default 125
    range 50 1000
    depends on CAN_SPEED_USER_KBPS
    help
        You can set your USER CAN Speed by input int 
		Range 50 ... 1000 kBit/s
		Be sure your Speed is supported by your HW / BUS
		
endchoice

choice ESP_CAN_TEST_SENDING
    prompt "enable/disable to send a test frame"
	default 0
	depends on ESPCAN
	help
		You can select enable/disable to Send Test Frames 

config CAN_TEST_SENDING_ENABLED
    bool "TEST SENDING ENABLED"
    help
        enabled: a Test Frame with counter is send all 1000ms

config CAN_TEST_SENDING_DISABLED
    bool "TEST SENDING DISABLED"
    help
        disabled: a Test Frame with counter is not send 
		
endchoice
```
