## components/platform/Kconfig
```kconfig
menu "NodeMCU platform config"

    config NODEMCU_NODE_DEBUG
        bool "Enable NODE_DBG() output"
        default "n"
        help
            Enable debugging output via NODE_DBG(). This is VERY chatty.
            For development/debugging use only.

    config NODEMCU_NODE_ERR
        bool "Enable NODE_ERR() output"
        default "y"
        help
            Enable error reporting via NODE_ERR().

            It is recommended to leave this enabled - if it ever produces
            output, something has gone seriously wrong and you probably want
            to know about it.

    config NODEMCU_DEFAULT_SPIFFS_LABEL
        string "Partition label of SPIFFS to mount as default file system"
        default ""
        help
            If there are multiple SPIFFS partitions, this setting can
            be used to control which partition gets mounted as the
            default file system. Leaving it empty defaults to using
            the first SPIFFS partition found.

    config NODEMCU_MAX_OPEN_FILES
        int "Maximum number of open files"
        default 4
        help
            This sets the maximum number of open files at the same time.
            Technically, it's per file system, but the most common use
            case only has a single file system (internal SPIFFS) so in
            that case it is the number of concurrent files that can be
            opened. Raising this limit will incur some extra memory
            overhead.

    config NODEMCU_EMBED_LFS
        bool "Embed LFS as part of the NodeMCU firmware"
        default "n"
        help
            The LFS (Lua Flash Store) normally has its own partition entry,
            and can can be replaced at will. Optionally, the LFS can instead
            be permanently embedded into the NodeMCU firmware image itself.
            This can be useful for scenarios where over-the-air firmware
            upgrades are needed to also bundle Lua code. The major downside
            is that once embedded, the LFS can no longer be changed, as
            doing so would break the firmware checksums and signatures and
            leave the system unable to boot.

            The default option is to not embed the LFS, in which case LFS is
            looked for in a partition of type 0xC2 and subtype 0x01.

            To embed LFS data into firmware, use:
              ./tools/embed_lfs.sh /path/to/file1.lua /path/to/file2.lua ...

    config NODEMCU_EMBEDDED_LFS_SIZE
        hex "Embedded LUA Flash Store size"
        default 0x0
        depends on NODEMCU_EMBED_LFS
        help
            Embedded LUA Flash Store size. Set to zero to use an LFS partition
            instead of embedding the LFS within the NodeMCU firmware itself.

    menu "UART buffer size configuration"

        config NODEMCU_UART_AT_LEAST_2
            bool
            default y if IDF_TARGET_ESP32
            default y if IDF_TARGET_ESP32S2
            default y if IDF_TARGET_ESP32S3
            default y if IDF_TARGET_ESP32C3
            default y if IDF_TARGET_ESP32C6
            default y if IDF_TARGET_ESP32H2

        config NODEMCU_UART_AT_LEAST_3
            bool
            default y if IDF_TARGET_ESP32
            default y if IDF_TARGET_ESP32S3

        config NODEMCU_UART_DRIVER_BUF_SIZE_RX0
            int "RX buffer size for UART0"
            default 512
            help
                The rx buffer size to use for UART0.
                This is a buffer used to/from the UART ISR. For high-speed scenarios,
                it can be very helpful to increase the rx size.  The ISR trying
                to write to a full rx buffer results in lost data and an error
                event posted.

        config NODEMCU_UART_DRIVER_BUF_SIZE_TX0
            int "TX buffer size for UART0"
            default 512
            help
                The tx buffer size to use for UART0.
                This is a buffer used to/from the UART ISR. In some scenarios it
                can be helpful to increase the tx size. Writing to a full tx buffer
                blocks the calling RTOS task.

        config NODEMCU_UART_DRIVER_BUF_SIZE_RX1
            int "RX buffer size for UART1"
            depends on NODEMCU_UART_AT_LEAST_2
            default 512
            help
                The rx buffer size to use for UART1.
                This is a buffer used to/from the UART ISR. For high-speed scenarios,
                it can be very helpful to increase the rx size.  The ISR trying
                to write to a full rx buffer results in lost data and an error
                event posted.

        config NODEMCU_UART_DRIVER_BUF_SIZE_TX1
            int "TX buffer size for UART1"
            depends on NODEMCU_UART_AT_LEAST_2
            default 512
            help
                The tx buffer size to use for UART1.
                This is a buffer used to/from the UART ISR. In some scenarios it
                can be helpful to increase the tx size. Writing to a full tx buffer
                blocks the calling RTOS task.

        config NODEMCU_UART_DRIVER_BUF_SIZE_RX2
            int "RX buffer size for UART2"
            depends on NODEMCU_UART_AT_LEAST_3
            default 512
            help
                The rx buffer size to use for UART2.
                This is a buffer used to/from the UART ISR. For high-speed scenarios,
                it can be very helpful to increase the rx size.  The ISR trying
                to write to a full rx buffer results in lost data and an error
                event posted.

        config NODEMCU_UART_DRIVER_BUF_SIZE_TX2
            int "TX buffer size for UART2"
            depends on NODEMCU_UART_AT_LEAST_3
            default 512
            help
                The tx buffer size to use for UART2.
                This is a buffer used to/from the UART ISR. In some scenarios it
                can be helpful to increase the tx size. Writing to a full tx buffer
                blocks the calling RTOS task.

    endmenu

endmenu
```

## components/task/Kconfig
```kconfig
menu "NodeMCU task slot configuration"

    config NODEMCU_TASK_SLOT_MEMORY
        int "Task slot buffer size"
        default 2000
        range 80 16000
        help
            NodeMCU uses a fixed size RTOS queue for messaging between internal
            LVM tasks as well as from other RTOS tasks. If this queue is too
            small, events and data will go missing. On the other hand, if the
            queue is too big, some memory will go unused.

            The default value is chosen to be on the safe side for most use
            cases. Lowering this value will yield more available RAM for use
            in Lua, but at the increased risk of data loss. Conversely,
            increasing this value can help resolve aforementioned data loss
            issues, if encountered.

            The assigned memory size here gets partitioned to the different
            task priorities; some rounding down may take place as a result.

endmenu
```

## components/ucg/Kconfig.ucg
```kconfig
menu "Displays"
    depends on NODEMCU_CMODULE_UCG

    config UCG_DISPLAY_HX8352C_18X240X400
        depends on NODEMCU_CMODULE_SPI
        bool "hx8352c_18x240x400_hw_spi"
        default "n"

    config UCG_DISPLAY_ILI9163_18X128X128
        depends on NODEMCU_CMODULE_SPI
        bool "ili9163_18x128x128_hw_spi"
        default "n"

    config UCG_DISPLAY_ILI9341_18X240X320
        depends on NODEMCU_CMODULE_SPI
        bool "ili9341_18x240x320_hw_spi"
        default "y"

    config UCG_DISPLAY_ILI9486_18X320X480
        depends on NODEMCU_CMODULE_SPI
        bool "ili9486_18x320x480_hw_spi"
        default "n"

    config UCG_DISPLAY_PCF8833_16X132X132
        depends on NODEMCU_CMODULE_SPI
        bool "pcf8833_16x132x132_hw_spi"
        default "n"

    config UCG_DISPLAY_SEPS225_16X128X128_UNIVISION
        depends on NODEMCU_CMODULE_SPI
        bool "seps225_16x128x128_uvis_hw_spi"
        default "n"

    config UCG_DISPLAY_SSD1351_18X128X128_ILSOFT
        depends on NODEMCU_CMODULE_SPI
        bool "ssd1351_18x128x128_hw_spi"
        default "n"

    config UCG_DISPLAY_SSD1351_18X128X128_FT
        depends on NODEMCU_CMODULE_SPI
        bool "ssd1351_18x128x128_ft_hw_spi"
        default "n"

    config UCG_DISPLAY_SSD1331_18X96X64_UNIVISION
        depends on NODEMCU_CMODULE_SPI
        bool "ssd1331_18x96x64_uvis_hw_spi"
        default "n"

    config UCG_DISPLAY_ST7735_18X128X160
        depends on NODEMCU_CMODULE_SPI
        bool "st7735_18x128x160_hw_spi"
        default "y"

endmenu

menu "Fonts"
    depends on NODEMCU_CMODULE_UCG

    config UCG_FONT_SELECTION
        depends on NODEMCU_CMODULE_UCG
        string  "Font list"
        default "font_7x13B_tr,font_helvB08_hr,font_helvB10_hr,font_helvB12_hr,font_helvB18_hr,font_ncenB24_tr,font_ncenR12_tr,font_ncenR14_hr"
        help
            Enter a comma-separated list of fonts.

endmenu
```

## extcomp-template/Kconfig
```kconfig
config NODEMCU_CMODULE_MYMOD
    bool "External NodeMCU module: mymod"
    default "y"
    help
        Includes the mymod module. This module is only an example for
        showing how to use external modules. Note that the config option
        name has to be prefixed with NODEMCU_CMODULE_ and the module
        registered with extmod_register_conditional(MYMOD) in CMakeLists.txt
```

## sdkconfig.defaults
```kconfig
# Default to 4MB for builds
CONFIG_ESPTOOLPY_FLASHSIZE_4MB=y

# Set custom partition table for 1.5MB firmware
CONFIG_PARTITION_TABLE_CUSTOM=y
CONFIG_PARTITION_TABLE_CUSTOM_FILENAME="components/platform/partitions.csv"
CONFIG_PARTITION_TABLE_SINGLE_APP=n
CONFIG_PARTITION_TABLE_TWO_OTA=n

# Squeeze in as much code as we can manage
CONFIG_COMPILER_OPTIMIZATION_SIZE=y

# Empirical value to prevent a firmware crash due to stack overflow.
CONFIG_ESP_MAIN_TASK_STACK_SIZE=8192

# Enable panic handler for task wdt to reset the firmware upon wdt timeout
CONFIG_ESP_TASK_WDT_PANIC=y

# Disable advanced features by default
CONFIG_MQTT_TRANSPORT_SSL=n
CONFIG_MQTT_TRANSPORT_WEBSOCKET=n
CONFIG_MQTT_USE_CUSTOM_CONFIG=n

# Enable address reuse for sockets in TIME_WAIT
# see https://github.com/nodemcu/nodemcu-firmware/pull/1838
CONFIG_LWIP_SO_REUSE=y

# Decrease the duration of sockets in TIME_WAIT
# see https://github.com/nodemcu/nodemcu-firmware/issues/1836
CONFIG_LWIP_TCP_MSL=5000

# Disable esp-idf's bluetooth component by default.
# The bthci module is also disabled and will enable bt when selected
CONFIG_BT_ENABLED=n

# Disable CR/LF translation, for legacy compatibility
CONFIG_NEWLIB_STDIN_LINE_ENDING_LF=y
CONFIG_NEWLIB_STDOUT_LINE_ENDING_LF=y
```
